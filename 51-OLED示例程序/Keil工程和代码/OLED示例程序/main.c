//		@布丁橘长  20220715
//		OLED显示汉字，字符，字符串，变量，时钟，图片，动画效果示例程序

#include <reg51.h>								//51通用头文件	
#include <oled.h>									//OLED库函数

#define uchar unsigned char				//用uchar 表示 unsigned char类型
#define uint unsigned int					//用uint 表示 unsigned int类型

void Timer0Init(void);						//定时器0初始化（仅演示时钟效果用，非必要）

uint count;												//定时器计时变量（仅演示时钟效果用，非必要）
uchar hour,min,sec;								//时钟变量时分秒（仅演示时钟效果用，非必要）

extern uchar code BMP0[];					//oledfont.h中，图片0取模数组，做外部变量声明（如用到更多图片，均需要声明）
extern uchar code BMP1[];					//oledfont.h中，图片0取模数组，做外部变量声明（如用到更多图片，均需要声明）
void main(void)
{	
	OLED_Init();										//初始化OLED  
	OLED_Clear();										//清空屏幕
	
	Timer0Init();										//定时器0初始化 （仅演示时钟效果用，非必要）
	hour = 23;											//初始时间：23时（仅演示时钟效果用，非必要）
	min = 59;												//初始时间：59分（仅演示时钟效果用，非必要）
	sec = 00;												//初始时间：00秒（仅演示时钟效果用，非必要）
	while(1) 
	{	
//------------------------------------------------------------------------------------------------------------------------------
//----------------------示例：显示16*16像素汉字函数-----------------------------------------------------------------------------
//------函数：OLED_ShowCHinese(0 ,0,0); 
//------第一个形参列坐标：0：第0列像素（取值范围0—127列），16*16汉字宽为16列像素，下一个字至少从16列像素开始 
//------第二个形参行坐标：0：第0页（取值0-7页）（可以理解为：共8页，每页8行像素，共64行像素，16*16汉字每个字占2页共16行像素）
//------第三个形参汉字库编号：0：显示哪个中文，oledfont.h字库中Hzk[]对应的汉字顺序，例如：‘布’为Hzk[0],取值0，‘丁’为Hzk[1],取值1

				OLED_ShowCHinese(0 ,0,0);				//布	从第0列（占用0-15，共16列）、   第0页（占0-1页：0-16行像素）、Hzk[0]:‘布’
				OLED_ShowCHinese(18,0,1);				//丁  从第18列（空2列，占用18-33列）、第0页（占0-1页：0-16行像素）、Hzk[1]:‘丁’
				OLED_ShowCHinese(36,0,2);				//橘	从第36列（空2列，占用36-51列）、第0页（占0-1页：0-16行像素）、Hzk[2]:‘橘’
				OLED_ShowCHinese(54,0,3);				//长	从第54列（空2列，占用54-69列）、第0页（占0-1页：0-16行像素）、Hzk[3]:‘长’
//-------------------------------------------------------------------------------------------------------------------------------

//----------------------示例：显示单个字符函数-----------------------------------------------------------------------------------
//------函数：OLED_ShowChar(71,2,1,8); 
//------第一个形参列坐标：71：第71列像素（取值范围0—127列）开始显示该字符
//------第二个形参行坐标：2： 第2页（取值范围0-7页，每页8行像素）
//------第三个形参字符：'A'：字符‘A’
//------第四个形参字符大小：8：字符点阵大小，取值8:F6*8[]字符集，字符大小6*8像素。取值16：F8*16[]字符集，字符大小8*16像素	
				OLED_ShowChar(71,2,'A',8);		//‘b’ 从第71列像素、第2页（第16行像素）开始显示大小为6*8像素的字符‘A’
				OLED_ShowChar(77,2,'b',8);		//‘&’ 从第77列像素、第2页（第16行像素）开始显示大小为6*8像素的字符‘b’
				OLED_ShowChar(83,2,'&',8);		//‘%’ 从第83列像素、第2页（第16行像素）开始显示大小为6*8像素的字符‘&’
				OLED_ShowChar(89,2,'1',8);		//‘1’ 从第89列像素、第2页（第16行像素）开始显示大小为6*8像素的字符‘1’
				
				OLED_ShowChar(95,2,'A',16);		//‘A’ 从第95列像素、 第2页（第16行像素）开始显示大小为8*16像素的字符‘A’	
				OLED_ShowChar(103,2,'b',16);	//‘b’ 从第103列像素、第2页（第16行像素）开始显示大小为8*16像素的字符‘b’
				OLED_ShowChar(111,2,'&',16);	//‘&’ 从第111列像素、第2页（第16行像素）开始显示大小为8*16像素的字符‘&’
				OLED_ShowChar(119,2,'1',16);	//‘%’ 从第119列像素、第2页（第16行像素）开始显示大小为8*16像素的字符‘1’
//-------------------------------------------------------------------------------------------------------------------------------

//----------------------示例：显示字符串函数-------------------------------------------------------------------------------------
//------函数：OLED_ShowString(71,4,"Ab123%&",8);
//------第一个形参列坐标：71：第71列像素（取值范围0—127列）开始显示该字符
//------第二个形参行坐标：4： 第4页（取值范围0-7页，每页8行像素）
//------第三个形参字符串："Ab123%&"：字符串："Ab123%&"
//------第四个形参字符大小：8：字符点阵大小，取值8:F6*8[]字符集，字符大小6*8像素。取值16：F8*16[]字符集，字符大小8*16像素	
				OLED_ShowString(71,4,"Ab123%&",8); //从第71列像素、第4页（第32行像素）开始显示大小为6*8像素的字符串"Ab123%"
				
				OLED_ShowString(71,5,"Ab123%&",16); //从第71列像素、第4页（第40行像素）开始显示大小为8*16像素的字符串"Ab123%"
//-------------------------------------------------------------------------------------------------------------------------------
		
//----------------------示例：显示变量值函数-------------------------------------------------------------------------------------
//------函数：OLED_ShowNum(71,7,sec,2,8);
//------第一个形参列坐标：71：第71列像素（取值范围0—127列）开始显示该字符
//------第二个形参行坐标：7： 第7页（取值范围0-7页，每页8行像素）
//------第三个形参变量：sec：时钟秒变量
//------第四个形参变量长度：2：2位
//------第五个形参字符大小：8：字符点阵大小，取值8:F6*8[]字符集，字符大小6*8像素。取值16：F8*16[]字符集，字符大小8*16像素	
				OLED_ShowNum(71,7,sec%10,1,8);	//时钟秒个位，从第71列，第7页（56行像素）开始显示大小为6*8像素的字符，变量位数：1位
				
				OLED_ShowNum(100,7,count,4,8);	//变量count值，从第100列，第7页（56行像素）开始显示大小为6*8像素的字符，变量位数：4位
//-------------------------------------------------------------------------------------------------------------------------------

//----------------------示例：显示图片函数---------------------------------------------------------------------------------------
//------函数：OLED_DrawBMP(0,2,64,8,BMP0);
//------第一个形参起始列坐标：0：第0列像素（取值范围0—127列）开始
//------第二个形参起始行坐标：2：第2页（取值范围0-7页，每页8行像素）开始
//------第三个形参结束列坐标：64：第64列像素（取值范围0—127列）借宿
//------第四个形参结束行坐标：7：第7页（取值范围0-7页，每页8行像素）结束
//------第五个形参图片数组名：BMP0，需要在主函数声明外部变量，extern uchar code BMP0[];
				OLED_DrawBMP(0,2,64,7,BMP0);	//从第0列第2页开始，第64列第7页结束，这个范围内显示图片BMP0（图片字模在oledfont.h中）
				OLED_DrawBMP(0,2,64,7,BMP1);	//从第0列第2页开始，第64列第7页结束，这个范围内显示图片BMP1（图片字模在oledfont.h中）
//------------------------------------------------------------------------------------------------------------------------------

//-------------------示例：显示时钟效果（仅做演示效果，非必要）-----------------------------------------------------------------
				OLED_ShowNum(78,0,hour/10,1,8);	//小时十位
				OLED_ShowNum(84,0,hour%10,1,8);	//小时十位
				OLED_ShowString(90,0,":",8);		//小时后面的冒号
				OLED_ShowNum(96,0,min/10,1,8);	//分钟十位
				OLED_ShowNum(102,0,min%10,1,8);	//分钟个位
				OLED_ShowString(108,0,":",8);		//分钟后面的冒号
				OLED_ShowNum(114,0,sec/10,1,8);	//秒钟十位		
				OLED_ShowNum(120,0,sec%10,1,8);	//秒钟个位
//------------------------------------------------------------------------------------------------------------------------------
	}
}

void Timer0Init(void)							//20毫秒@11.0592MHz（非必要，仅做演示时钟用）
{
	TMOD |= 0x01;										//设置定时器模式
	TL0 = 0x00;											//设置定时初始值
	TH0 = 0xB8;											//设置定时初始值
	TR0 = 1;												//定时器0开始计时
	ET0 = 1;												//定时器0中断使能
	EA = 1;													//总中断使能
}

void Tmr0isr () interrupt 1				//延时时钟效果（非必要，仅做演示时钟用）
{
	TL0 = 0x00;											//设置定时初始值
	TH0 = 0xB8;											//设置定时初始值 20毫秒@11.0592MHz
	count++;												//计时，每个count20毫秒
	if(count >=10000) count = 0;		//防溢出
	if(count%50==0) sec++;					//计时，50个count为1秒
	if(sec == 60) 									//60秒1分钟
	{
		sec = 0;
		min++;
	}
	if(min == 60)										//60分钟1小时
	{
		min = 0;
		hour++;
	}
	if(hour == 24)									//24小时制
	{
		hour = 0;
	}
}